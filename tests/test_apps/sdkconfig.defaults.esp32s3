## tests/test_apps/sdkconfig.defaults.esp32s3
```kconfig
CONFIG_ESP_COREDUMP_DATA_FORMAT_BIN=y
CONFIG_SPIRAM=y
CONFIG_SPIRAM_ALLOW_STACK_EXTERNAL_MEMORY=y
CONFIG_ESP_SYSTEM_ALLOW_RTC_FAST_MEM_AS_HEAP=y
```
